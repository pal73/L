_Table95:
	.DB  0x0,0x2A,0x54,0x7E,0xA8,0x82,0xFC,0xD6
	.DB  0x7A,0x50,0x2E,0x4,0xD2,0xF8,0x86,0xAC
	.DB  0xF4,0xDE,0xA0,0x8A,0x5C,0x76,0x8,0x22
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	.DB  0x94,0xBE,0xC0,0xEA,0x3C,0x16,0x68,0x42
_Table87:
	.DB  0x0,0xE,0x1C,0x12,0x38,0x36,0x24,0x2A
	.DB  0x70,0x7E,0x6C,0x62,0x48,0x46,0x54,0x5A
	.DB  0xE0,0xEE,0xFC,0xF2,0xD8,0xD6,0xC4,0xCA
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	.DB  0xCE,0xC0
	.DEF _p_ust=R8
	.DEF _plazma=R10
	.DEF _p_ind_cnt=R12
	.DEF _ind=R13
_DAY_MONTHS:
	.DB  0x1F,0x1D,0x1F,0x1E,0x1F,0x1E,0x1F,0x1F
	.DB  0x1E,0x1F,0x1E,0x1F
___weeks_days_:
	.DB  0x20,0x20,0x20,0x0,0x0,0x0,0x0,0x0
	.DB  0x0,0x0,0x0,0x0,0x0,0x0,0x0,0xE2
	.DB  0xEE,0xF1,0xEA,0xF0,0x2E,0x0,0x0,0x0
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	.DB  0x0,0x0,0x0,0x0,0x0,0x0,0x0,0x0
	.DEF _out_stat=R14
_17:
	.DW  0x87,0x14F,0x217
_18:
	.DB  0x19
_19:
	.DB  0x81
_20:
	.DB  0x81,0x81,0x81,0x81,0x81,0x81
_21:
	.DB  0x81,0x81,0x81,0x81,0x81,0x81
_22:
	.DB  0xAA
_23:
	.DB  0xAA,0xAA,0xAA,0xAA,0xAA,0xAA
_24:
	.DB  0xAA,0xAA,0xAA,0xAA,0xAA,0xAA
_25:
	.DB  0xAA,0xAA,0xAA,0xAA,0xAA,0xAA
_26:
	.DB  0xAA,0xAA,0xAA,0xAA,0xAA,0xAA
_27:
	.DB  0xAA,0xAA,0xAA,0xAA,0xAA,0xAA
_28:
	.DB  0xAA,0xAA,0xAA,0xAA,0xAA,0xAA
_29:
	.DW  0x7F
_30:
	.DB  0xAA
_ABC:
	.DB  0x30,0x31,0x32,0x33,0x34,0x35,0x36,0x37
	.DB  0x38,0x39,0x41,0x42,0x43,0x44,0x45,0x46
_sm_:
	.DB  0x20,0x20,0x20,0x20,0x20,0x20,0x20,0x20
	.DB  0x20,0x20,0x20,0x20,0x20,0x20,0x20,0x20
	.DB  0x0
_sm_exit:
	.DB  0x20,0xC2,0xFB,0xF5,0xEE,0xE4,0x20,0x20
	.DB  0x20,0x20,0x20,0x20,0x20,0x20,0x20,0x20
	.DB  0x0
_sm_mont:
	.DB  0xFF,0xED,0xE2,0x0,0xF4,0xE5,0xE2,0x0
	.DB  0xEC,0xE0,0xF0,0x0,0xE0,0xEF,0xF0,0x0
	.DB  0xEC,0xE0,0xE9,0x0,0xE8,0xFE,0xED,0x0
	.DB  0xE8,0xFE,0xEB,0x0,0xE0,0xE2,0xE3,0x0
	.DB  0xF1,0xE5,0xED,0x0,0xEE,0xEA,0xF2,0x0
	.DB  0xED,0xEE,0xFF,0x0,0xE4,0xE5,0xEA,0x0
_sm_av:
	.DB  0x30,0x30,0x0,0x30,0x31,0x0,0x30,0x32
	.DB  0x0,0x30,0x33,0x0,0x30,0x34,0x0,0x30
	.DB  0x35,0x0,0x30,0x36,0x0,0x30,0x37,0x0
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	.DB  0xE3,0x0,0x36,0xE4,0x0,0x36,0xE5,0x0
_rus_buff:
	.DB  0xFD,0xA2,0xFF,0xAA,0xC8,0xAC,0xAD,0xAE
	.DB  0xAF,0xB0,0xB1,0xD7,0x69,0xB4,0xB5,0xFE
	.DB  0xDF,0xB5,0xCC,0xBA,0xC9,0xBC,0xBD,0xBE
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	.DB  0xC7
_auchCRCHi:
	.DB  0x0,0xC1,0x81,0x40,0x1,0xC0,0x80,0x41
	.DB  0x1,0xC0,0x80,0x41,0x0,0xC1,0x81,0x40
	.DB  0x1,0xC0,0x80,0x41,0x0,0xC1,0x81,0x40
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	.DB  0x1,0xC0,0x80,0x41,0x0,0xC1,0x81,0x40
_auchCRCLo:
	.DB  0x0,0xC0,0xC1,0x1,0xC3,0x3,0x2,0xC2
	.DB  0xC6,0x6,0x7,0xC7,0x5,0xC5,0xC4,0x4
	.DB  0xCC,0xC,0xD,0xCD,0xF,0xCF,0xCE,0xE
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	.DB  0x82,0x42,0x43,0x83,0x41,0x81,0x80,0x40
_0x7E:
	.DB  0x0
_154:
	.DB  0xAA
_155:
	.DB  0xAA
_156:
	.DB  0xAA,0xAA,0xAA,0xAA,0xAA,0xAA
_0x1CE:
	.DB  0x0
_0:
	.DB  0x20,0x0,0x20,0x21,0x20,0x20,0x30,0x40
	.DB  0x3A,0x30,0x23,0x20,0x30,0x24,0x30,0x25
	.DB  0x30,0x3C,0x0,0x20,0xC0,0xE2,0xE0,0xF0
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	.DB  0xED,0xE8,0xE7,0x20,0x20,0x21,0x25,0x0

;REGISTER BIT VARIABLES INITIALIZATION
__REG_BIT_VARS:
	.DW  0x0000
	.DW  0x0002

__GLOBAL_INI_TBL:
	.DW  0x04
	.DW  0x02
	.DW  __REG_BIT_VARS*2

	.DW  0x06
	.DW  _unet
	.DW  _17*2

	.DW  0x01
	.DW  _cher_cnt
	.DW  _18*2

	.DW  0x01
	.DW  _fp_stat
	.DW  _19*2

	.DW  0x06
	.DW  _dv_on
	.DW  _20*2

	.DW  0x06
	.DW  _dv_access
	.DW  _21*2

	.DW  0x01
	.DW  _av_pereliv
	.DW  _22*2

	.DW  0x06
	.DW  _av_i_dv_min
	.DW  _23*2

	.DW  0x06
	.DW  _av_i_dv_max
	.DW  _24*2

	.DW  0x06
	.DW  _av_i_dv_not
	.DW  _25*2

	.DW  0x06
	.DW  _av_i_dv_log
	.DW  _26*2

	.DW  0x06
	.DW  _av_i_dv_log_old
	.DW  _27*2

	.DW  0x06
	.DW  _apv
	.DW  _28*2

	.DW  0x02
	.DW  _height_level
	.DW  _29*2

	.DW  0x01
	.DW  _av_ls_stat
	.DW  _30*2

	.DW  0x02
	.DW  _lcd_buffer
	.DW  _0*2

	.DW  0x01
	.DW  _av_sens_p_stat
	.DW  _154*2

	.DW  0x01
	.DW  _av_fp_stat
	.DW  _155*2

	.DW  0x06
	.DW  _fp_apv
	.DW  _156*2

	.DW  0
