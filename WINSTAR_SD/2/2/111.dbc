VERSION ""

NS_ :

BS_:

BU_:

BO_ 387 Text_Message_1: 8 Vector__XXX
 SG_ Text_Signal_1 : 0|64@1+ (1,0) [0|16777215] "" Vector__XXX

BO_ 386 Button_signals: 2 Vector__XXX
 SG_ Butt_sign_1 : 1|1@1+ (1,0) [0|1] "" Vector__XXX
 SG_ Butt_sign_0 : 0|1@1+ (1,0) [0|1] "" Vector__XXX

BO_ 385 New_Message_1: 2 Vector__XXX
 SG_ New_Signal_1 : 0|16@1- (1,0) [-5|100] "Volt" Vector__XXX

BA_DEF_  "BusType" STRING ;
BA_DEF_DEF_  "BusType" "CAN";
